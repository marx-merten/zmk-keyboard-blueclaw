## boards/shields/cf_statusview/Kconfig.defconfig
```kconfig
# Copyright (c) 2023 The ZMK Contributors
# SPDX-License-Identifier: MIT

if SHIELD_CF_STATUSVIEW


config LV_Z_BITS_PER_PIXEL
    default 1

choice LV_COLOR_DEPTH
    default LV_COLOR_DEPTH_1
endchoice

choice ZMK_DISPLAY_WORK_QUEUE
    default ZMK_DISPLAY_WORK_QUEUE_DEDICATED
endchoice


choice ZMK_DISPLAY_STATUS_SCREEN
    default ZMK_DISPLAY_STATUS_SCREEN_CUSTOM
endchoice

config LV_Z_MEM_POOL_SIZE
    default 4096 if ZMK_DISPLAY_STATUS_SCREEN_CUSTOM

config ZMK_DISPLAY_STATUS_SCREEN_CUSTOM
    imply CF_VIEW_WIDGET_STATUS

config CF_VIEW_WIDGET_STATUS
    bool "Custom codingfragment status screen"
    select LV_USE_CONT
    select LV_USE_LABEL
    select LV_USE_IMG

    select LV_FONT_MONTSERRAT_12
    select LV_FONT_MONTSERRAT_14

    select LV_FONT_MONTSERRAT_16
    select LV_USE_IMG
    select LV_USE_CANVAS
    select LV_USE_BAR




menuconfig CUSTOM_WIDGET_BATTERY_STATUS
    bool "custom battery status widget"

config CUSTOM_WIDGET_SPLIT_STATUS
    bool "custom split status widget"


menuconfig CUSTOM_WIDGET_OUTPUT_STATUS
    bool "custom output status widget"

menuconfig CUSTOM_WIDGET_LAYER_STATUS
    bool "custom layer status widget"

menuconfig CUSTOM_WIDGET_PERIPHERAL_STATUS
    bool "custom peripheral status widget"

config NICE_VIEW_WIDGET_INVERTED
    bool "Invert custom status widget colors"

if !ZMK_SPLIT || ZMK_SPLIT_ROLE_CENTRAL

#config CF_VIEW_WIDGET_STATUS
#    select LV_FONT_MONTSERRAT_18
#    select LV_FONT_MONTSERRAT_14
#    select LV_FONT_UNSCII_8
#    select ZMK_WPM

endif # !ZMK_SPLIT || ZMK_SPLIT_ROLE_CENTRAL

#config ZMK_DISPLAY_STATUS_SCREEN_BUILT_IN
#    select LV_FONT_MONTSERRAT_26

endif # SHIELD_NICE_VIEW
```

## boards/shields/cf_statusview/Kconfig.shield
```kconfig
# Copyright (c) 2022 The ZMK Contributors
# SPDX-License-Identifier: MIT

config SHIELD_CF_STATUSVIEW
    def_bool $(shields_list_contains,cf_statusview)
```

## config/boards/shields/blueclaw/Kconfig.defconfig
```kconfig
if SHIELD_BLUECLAW_LEFT

    config ZMK_KEYBOARD_NAME
        default "blueclaw"

    config ZMK_SPLIT_ROLE_CENTRAL
        default y

endif


if SHIELD_BLUECLAW_LEFT_STUDIO

    config ZMK_KEYBOARD_NAME
        default "blueclaw_studio"

    config ZMK_SPLIT_ROLE_CENTRAL
        default y

endif






if SHIELD_BLUECLAW_LEFT || SHIELD_BLUECLAW_RIGHT || SHIELD_BLUECLAW_MASTER || SHIELD_BLUECLAW_SLAVELEFT || SHIELD_BLUECLAW_MASTER_STUDIO || SHIELD_BLUECLAW_LEFT_STUDIO

    config ZMK_SPLIT
        default y

endif


if SHIELD_BLUECLAW_SLAVELEFT || SHIELD_BLUECLAW_LEFT
endif

# TODO need to find a way to limit the duplicates, maybe i can define a _studio generic cmake switch and use this
if SHIELD_BLUECLAW_MASTER 
    config ZMK_KEYBOARD_NAME
        default "greyclaw_master"

    config ZMK_SPLIT_ROLE_CENTRAL
        default y

    config ZMK_SPLIT_BLE_CENTRAL_PERIPHERALS
        default 2

    config ZMK_EXT_POWER
        default n

endif

if SHIELD_BLUECLAW_MASTER_STUDIO
    config ZMK_KEYBOARD_NAME
        default "greyclaw_studio"

    config ZMK_SPLIT_ROLE_CENTRAL
        default y

    config ZMK_SPLIT_BLE_CENTRAL_PERIPHERALS
        default 2

    config ZMK_EXT_POWER
        default n

endif
```

## config/boards/shields/blueclaw/Kconfig.shield
```kconfig
# Copyright (c) 2020 Pete Johanson
# SPDX-License-Identifier: MIT

config SHIELD_BLUECLAW_LEFT
    def_bool $(shields_list_contains,blueclaw_left)

config SHIELD_BLUECLAW_RIGHT
    def_bool $(shields_list_contains,blueclaw_right)

config SHIELD_BLUECLAW_MASTER
    def_bool $(shields_list_contains,blueclaw_master)

config SHIELD_BLUECLAW_MASTER_STUDIO
    def_bool $(shields_list_contains,blueclaw_master_studio)

config SHIELD_BLUECLAW_LEFT_STUDIO
    def_bool $(shields_list_contains,blueclaw_left_studio)

config SHIELD_BLUECLAW_SLAVELEFT
    def_bool $(shields_list_contains,blueclaw_slaveleft)
```
