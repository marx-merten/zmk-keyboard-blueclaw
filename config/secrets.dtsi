/*
 * Copyright (c) 2020 The ZMK Contributors
 *
 * SPDX-License-Identifier: MIT
 */

// this one will bbe replaced during secure build
// It will replace macro bindings with secrets

// &tt1 {
//             bindings = <&kp LS(N) &kp LS(I) &kp LS(N) &kp LS(E)>;

// };


// PLACEHOLDER Def, will be replaced during secure build
#define INJECT_SECRETS()
#if __has_include("private_secrets.dtsi")
    #include "private_secrets.dtsi"
#endif